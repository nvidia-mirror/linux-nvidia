## Documentation/devicetree/bindings/media/tegra-cdi-mgr.txt
```
NVIDIA tegra cdi-mgr driver

This file documents the properties used by the cdi-mgr driver in the Tegra
Platform.

Required properties:
- compatible: Should be "nvidia,cdi-mgr"
- i2c-bus: Should contain the I2C bus number that the device is attached to the
  Tegra for controlling the CDI.
- csi-port: Should contain the NVCSI port that the device is attached to the
  Tegra for image streaming.

Optional properties:
- pwdn-gpios: Should contain the list for gpios to control power in order of
  aggregator and camera instances.
- pwr-items: Map power items to the GPIO item specified in the pwdn-gpios list,
  starting from 0. For example, pwr-item 0 is for the deserializer, while
  pwr-item 1, 2, 3, 4 are for links 0, 1, 2, 3
- default-power-on: If this property is used, while probing the device,
  pwdn-gpios are powered on.
- runtime-pwrctrl-off: If this property is present, power control GPIOs retain
  the same status and are never changed.
- interrupt-parent: Should contain interrupt parent for GPIO interrupt.
- interrupts: Should contain the GPIO number that is connected to status pin in
  the CDI device.
- pwms: PWM property to point to the PWM chip, chip-relative PWM number and
  period in nanoseconds.

The pwr_ctrl node describes the methods control deserializer and camera module
power.

Optional properties:
- deserializer-pwr-gpio: The deserializer power is controlled by GPIO.
- cam-pwr-max20087: The external MAX20087 IC is used to control camera module
  link power, accessed over I2C.
- power_port: The GPIO expander port that controls deserializer power. Required
  if the tca9539 node is present.

Optional tca9539 node required properties:
- i2c-bus: Should contain the I2C bus number that the device is attached to the
  Tegra to.
- addr: The 7-bit I2C device address.
- reg_len: The register length, should be set to 8 bits.
- dat_len: The data length, should be set to 8 bits.

Optional max20087 node required properties:
- i2c-bus: Should contain the I2C bus number that the device is attached to the
  Tegra to.
- addr: The 7-bit I2C device address.
- reg_len: The register length, should be set to 8 bits.
- dat_len: The data length, should be set to 8 bits.
- links: Vector of camera module to power link control mappings.

Example:
sipl_devblk_0 {
	compatible = "nvidia,cdi-mgr";
	pwms = <&sipl_devblk_pwm_4 0 33333333>; /* PWM name, chip-relative PWM number, period in nano seconds */
	status = "okay";
	tegra {
		i2c-bus = <0>;
		csi-port = <0>;
		interrupt-parent = <&tegra_main_gpio>;
		interrupts = <TEGRA194_MAIN_GPIO(P, 5) 2>; /* GMSLA_STATUS_OC: falling edge sensitive */
	};

	deserializer {
		addr = <0x29>;   /* 7 bit slave address */
		reg_len = <16>;  /* 16 bit register length */
		dat_len = <8>;   /* 8 bit data length */
		des_i2c_port = <0>; /* I2C port number of the deserializer */
		/* des_tx_port = <0>;*/ /* CSI Tx port number. Define des_tx_port only if the dedicated output Tx port is required */
		dphy_rate_x2 = <2500000>; /* Data rate in DPHY x2. Unit size is kbps */
		dphy_rate_x4 = <2500000>; /* Data rate in DPHY x4. Unit size is kbps */
		cphy_rate_x2 = <2000000>; /* Data rate in CPHY x2. Unit size is ksps */
		cphy_rate_x4 = <1700000>; /* Data rate in CPHY x4. Unit size is ksps */
	};

	pwr_ctrl {
		power_port = <0>;
		deserializer-pwr-gpio; /* The deserializer's power is controlled by GPIO */
		cam-pwr-max20087; /* MAX20087 for the camera's power is controlled by I2C */

		tca9539 {
			i2c-bus = <7>;
			addr = <0x74>; /* 7 bit slave address */
			reg_len = <8>; /* 8 bit register length */
			dat_len = <8>;
		};
		max20087 {
			i2c-bus = <0>;
			addr = <0x28>; /* 7 bit slave address */
			reg_len = <8>; /* 8 bit register length */
			dat_len = <8>; /* 8 bit data length */
			links = <0 1 2 3>;	/*
				                 * camera module to power control link mappings
				                 * the values are the camera module indices
				                 */
		};
	};
};
```

## Documentation/devicetree/bindings/media/tegra-cdi-tsc.txt
```
NVIDIA tegra cdi-tsc driver

This file documents the properties used by the cdi-tsc driver in the Tegra Platform.

Required properties:
- compatible: Should be "nvidia,tegra234-cdi-tsc"

Generators describe discrete Tegra TSC signal outputs, enumerated as generator@<addr>.

Required properties:
- freq_hz: Frequency of the signal in Hertz.
- duty_cycle: Percentage duty cycle of the signal, 0 to 100.
- offset_ms: Offset to shift the signal in milliseconds.

Example:
tsc_sig_gen@c6a0000 {
	compatible = "nvidia,tegra234-cdi-tsc";
	ranges = <0x0 0x0 0xc6a0000 0x10000>;
	reg = <0x0 0xc6a0000 0x0 0x18>;
	#address-cells = <1>;
	#size-cells = <1>;
	status = "okay";

	generator@380 {
		reg = <0x380 0x80>;
		freq_hz = <30>;
		duty_cycle = <25>;
		offset_ms = <0>;
		status = "okay";
};
```

## Documentation/devicetree/bindings/tegra_hv/tegra_hv_vcpu_yield.txt
```
* Tegra Hypervisor VCPU Yield(tegra-hv-vcpu-yield)

Provides support for high priority Linux VM to yield Virtual CPU to a low
priority VM.
Linux VM which is of higher priority and sharing a Physical CPU with a lower
priority VM can yield the CPU(yield Virtual CPU corresponding to the Physical
CPU where the low priority VM runs) for a specific timeout period so that the
low priority VM can make progress.
ioctl is used to trigger the Virtual CPU yield with specific duration for the
yield.
ivc is used by low priority VM to notify the Linux VM that it is done using
CPU before the specified yield timeout expires.

Required properties:
- compatible: Should be "nvidia,tegra-hv-vcpu-yield".
- low_prio_vmid: list of low priority VM id's for which CPU need to be yielded
- yield_vcpu: Virtual CPU core corresponding to each of the low priority VM in
		low_prio_vmid that is shared with Linux VM
- ivc: IVC channel corresponding to each of the low priority VM in low_prio_vmid
		that is used by low priority VM to notify Linux VM that it is
		done using the CPU
- max_timeout_us: max timeout in uS per yield request(cap value). Any yield
		request with a yield timeout higher than this will fall back
		to this	value. Default value in driver if this is not passed in
		the dt is 1 Second. This needs to be set based on the system
		usecase.


Example:
	tegra_hv_vcpu_yield {
		compatible = "nvidia,tegra-hv-vcpu-yield";
		yield_vcpu = <2>;
		low_prio_vmid = <1>;
		ivc = <10>;
		max_timeout_us = <500000>;
		status = "okay";
	};
```

## Documentation/devicetree/bindings/video/nvidia,tegra234-ti-fpdlink-dp-ser.txt
```
TI FPDLink DP Serializer Driver

Required properties:
- compatible              : should be "ti,ti_fpdlink_dp_ser".
- reg                     : I2C address of the TI FPDLink display serializer.
- ti_fpdlink_dp_ser-pwrdn : GPIO pin number of the PWRDN pin.
                            This pin is used to power up the
                            TI display serializer chip.
- timings-phandle         : This property specifies the phandle that contains
                            the mode timings that the SOC will use to send
                            the video stream to the serializer.
- fpd-link-select         : This property is an array of two unsigned 8-bit
                            values that represent FPDlink port IDs. First field
                            is for link A and the second is for link B. Value 0
                            indicates that the link is disabled and value 1
                            indicates that the link is enabled. At any given time,
                            only one link is supported.

Optional properties:
- dprx-link-rate          : Configures the DP link rate of the serializer chip.
                            The default value is 0x1E (HBR3). The possible values are:
                            - 0xA (HBR),
                            - 0x14 (HBR2),
                            - 0x1E (HBR3).
- dprx-lane-count         : Configures the DP lane count of the serializer chip.
                            The default value is 0x4. The possible values are:
                            - 0x1,
                            - 0x2,
                            - 0x4.

Example:

	i2c@31e0000 { /* i2c8 */
		status = "okay";
		ti_ser: ti_fpdlink_dp_ser@18 {
			compatible = "ti,ti_fpdlink_dp_ser";
			reg = <0x18>;
			status = "okay";
			ti_fpdlink_dp_ser-pwrdn = <&tegra_main_gpio TEGRA234_MAIN_GPIO(G, 3) GPIO_ACTIVE_HIGH>;
			dprx-link-rate = <0x0A>;
			dprx-lane-count = <0x4>;
			timings-phandle = <&mode0>;
			fpd-link-select = <0x1 0x0>;
	};

	mode0: 1920-1080-60Hz {
		clock-frequency-khz = <148500>;
		hactive = <1920>;
		vactive = <1080>;
		hfront-porch = <88>;
		hback-porch = <148>;
		hsync-len = <44>;
		vfront-porch = <4>;
		vback-porch = <36>;
		vsync-len = <5>;
		rrx1k = <60000>;
	};
```

## arch/arm64/Kconfig
```kconfig
config ARCH_TEGRA_18x_SOC
	bool "Tegra 18x family SOC (Downstream options)"
	select CPU_V8
	select ARM_GIC
	select ARM_GIC_PM
	select COMMON_CLK
	select SOC_BUS
	select ARCH_REQUIRE_GPIOLIB
	select PINCTRL
	select ARCH_SUPPORTS_MSI if PCI_TEGRA
	select ARCH_TEGRA_APE
	select ARCH_HAS_RESET_CONTROLLER
	select ARM64_CPU_SUSPEND
	default n
	help
	  NVIDIA Tegra Downstream options for 18x family of SoCs

config ARCH_TEGRA_19x_SOC
	bool "Tegra 19x family SOC (Downstream options)"
	select PINCTRL
	default n
	help
	  NVIDIA Tegra Downstream options for 19x family of SoCs

config ARCH_TEGRA_21x_SOC
	bool "Tegra 21x family SOC (Downstream options)"
	default n
	help
	  NVIDIA Tegra Downstream options for 21x family of SoCs

config ARCH_TEGRA_23x_SOC
	bool "Tegra 23x family SOC (Downstream options)"
	select PINCTRL
	default n
	help
	  NVIDIA Tegra Downstream options for 23x family of SoCs

config ARCH_TEGRA_CHAIN_C
	bool "Add support for chain-c"
	default n
	help
	 Chain-c is emergency recovery boot chain for
	 automotive platform. All boot images need to
	 be part of QSPI storage for reliability and
	 need to be with minimal storage footprint.

config ARCH_TEGRA_HYPERVISOR
	bool "Add Tegra Hypervisor support"
	default n
	help
	 NVIDIA Tegra Downstream options for hypervisor. Since
	 Android Kernel 5.10, Tegra T23x enabled hypervisor
	 support. Some special dts is added for hypervisor mode.
	 But not all of platform enabled this support. Using
	 this flag to separate Android platform with others.

append_menu "Kernel Features"

config TEGRA_EBP
	bool "Tegra Early Boot Partition"
	select ARM64_NON_SHARED_TLBI
	select MINIMAL_GIC_INIT
	default n
	help
	  NVIDIA Tegra single core stripped down configuration
	  designed for fast boot time.

config TEGRA_PSC
	tristate "NVIDIA Tegra Option for PSC module"
	depends on ARCH_TEGRA_23x_SOC
	default y
	help
	  Enable NVIDIA Tegra Option for platform security controller

endmenu
```

## drivers/net/can/Kconfig
```kconfig
if CAN_DEV
source "drivers/net/can/mttcan/native/Kconfig"
source "drivers/net/can/mttcan/ivc/Kconfig"
endif
```

## drivers/net/wireless/ahd/Kconfig
```kconfig
#
# $ Copyright Open Broadcom $
# Copyright (c) 2023, NVIDIA CORPORATION.  All rights reserved.
#
# <<Broadcom-WL-IPTag/Open:>>
#

config AHD
	tristate "Broadcom FullMAC wireless cards support"
	help
	  This module adds support for wireless adapters based on
	  Broadcom FullMAC chipset.

	  If you choose to build a module, it'll be called dhd. Say M if
	  unsure.

config AHD_SDIO
	bool "SDIO bus interface support"
	depends on AHD && MMC

config AHD_PCIE
	bool "PCIe bus interface support"
	depends on AHD && PCI && !AHD_SDIO
	default y

config BCM4354
	tristate "BCM4354 support"
	depends on AHD

config BCM4356
	tristate "BCM4356 support"
	depends on AHD
	default n

config BCM4358
	tristate "BCM4358 support"
	depends on AHD
	default n

config BCM4359
	bool "BCM4359 support"
	depends on AHD
	default y

config BCM4361
	tristate "BCM4361 support"
	depends on AHD
	default n

config CYW89570
	tristate "CYW89570 support"
	depends on AHD
	default y

config DHD_OF_SUPPORT
	bool "Use in-drive platform device"
	depends on AHD
	default n

config ANDROID12
	bool "Android12 support"
	depends on AHD
	default y

config BCMDHD_FW_PATH
	depends on AHD
	string "Firmware path"
	default "/firmware/bcm54591.bin"
	help
	  Path to the firmware file.

config BCMDHD_NVRAM_PATH
	depends on AHD
	string "NVRAM path"
	default "/firmware/bcm54591.txt"
	help
	  Path to the calibration file.

config BROADCOM_WIFI_RESERVED_MEM
	bool "BROADCOM Reserved memory for wifi device"
	depends on AHD
	help
	  This is a configuration for Broadcom WLAN driver.

config AHD_WEXT
	bool "Enable WEXT support"
	depends on AHD && CFG80211 = n
	select WIRELESS_EXT
	select WEXT_PRIV
	help
	  Enables WEXT support

config DHD_USE_STATIC_BUF
	bool "Enable memory preallocation"
	depends on AHD
	default n
	help
	  Use memory preallocated in platform

config DHD_USE_SCHED_SCAN
	bool "Use CFG80211 sched scan"
	depends on AHD && CFG80211
	default n
	help
	  Use CFG80211 sched scan

config DHD_SET_RANDOM_MAC_VAL
	hex "Vendor OUI"
	depends on AHD
	default 0x001A11
	help
	  Set vendor OUI for SoftAP

config WLAN_REGION_CODE
	int "---Region codes for Broadcom WiFi Driver"
	depends on AHD
	default 100
	help
		This is a region code for Broadcom Wi-Fi featured functions.
		- 100 : EUR OPEN
		- 101 : EUR ORG
		- 200 : KOR OPEN
		- 201 : KOR SKT
		- 202 : KOR KTT
		- 203 : KOR LGT
		- 300 : CHN OPEN

config WLAIBSS
	bool "Advanced IBSS mode"
	depends on (BCM4335 || BCM4339 || BCM4354 || BCM4358 || BCM4359 || BCM4361)
	default y
	help
	  This is a configuration for Oxygen Network.

config WL_RELMCAST
	bool "Reliable Multicast Support"
	depends on (BCM4335 || BCM4339 || BCM4354 || BCM4358 || BCM4359 || BCM4361)
	default y
	help
	  This is a configuration for RMC.

config WL_NAN
	bool "NAN Feature"
	depends on AHD
	default n
	help
	  This is a configuration for NAN Feature.

config WL_AP_IF
	bool "Create additional AP interface during intialization"
	default n
	help
	  Create additional AP interface during initialization.

config AHD_PREALLOC_PKTIDMAP
	bool "BROADCOM PCIE specific memory reserved for PKTIDMAP"
	depends on BROADCOM_WIFI_RESERVED_MEM && AHD_PCIE
	help
	  Preallocated memory support for PCIE interface in Broadcom
	  WLAN driver.

config AHD_PREALLOC_MEMDUMP
	bool "BROADCOM PCIE specific memory reserved for MEMDUMP"
	depends on BROADCOM_WIFI_RESERVED_MEM
	help
	  Preallocated memory support for dongle memory dump

config AHD_OOB_HOST_WAKE
        bool "Use the external WLAN_HOST_WAKE pin"
        depends on AHD
        help
          Use the external GPIO pin to wake up host

config AHD_GET_OOB_STATE
        bool "Support WLAN_HOST_WAKE pin level information"
        depends on AHD_OOB_HOST_WAKE
        default y
        help
          Support WLAN_HOST_WAKE pin level information

config AHD_WPA3
	bool "Support WPA3 feature"
	depends on AHD
	default n
	help
	  This will enable WPA3 support
```

## drivers/nvpps/Kconfig
```kconfig
config NVPPS
	bool "Tegra NVPPS Support"
	depends on (ARCH_TEGRA_194_SOC || ARCH_TEGRA_19x_SOC)
	default y
	help
	  This config enables the Tegra NVPPS driver. NVPPS is the PPS
	  source driver for the Tegra SOC.
```

## drivers/platform/tegra/psc/Kconfig.tinylinux
```kconfig
menu "PSC driver for testing"

config TEGRA_PSC
        tristate "Enable Tegra PSC driver"
        help
         Enable the tegra23x_psc driver for PSCFW debugging from
         Linux user space.

         The driver creates /sys/kernel/debug/psc/mbox_dbg file system
         used by pscfw_sanity* tools
        default m

endmenu
```
